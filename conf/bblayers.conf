## conf/bblayers.conf
```bitbake
# POKY_BBLAYERS_CONF_VERSION is increased each time build/conf/bblayers.conf
# changes incompatibly
POKY_BBLAYERS_CONF_VERSION = "2"

BBPATH = "${TOPDIR}"
BBFILES ?= ""

BBLAYERS ?= " \
  /home/wafdunix/poky/meta \
  /home/wafdunix/poky/meta-poky \
  /home/wafdunix/poky/meta-yocto-bsp \
  /home/wafdunix/poky/meta-openembedded/meta-oe \
  /home/wafdunix/poky/meta-mender/meta-mender-core \
  /home/wafdunix/poky/meta-mender/meta-mender-demo \
  /home/wafdunix/poky/meta-openembedded/meta-python \
  /home/wafdunix/poky/meta-openembedded/meta-networking \
  /home/wafdunix/poky/meta-openembedded/meta-multimedia \
  /home/wafdunix/poky/meta-raspberrypi \
  /home/wafdunix/poky/meta-mender/meta-mender-raspberrypi \
  /home/wafdunix/poky/meta-AhmedWafdy \
  "
```
